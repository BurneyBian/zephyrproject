## zephyr/boards/acme/sa6920/Kconfig
```kconfig
# Copyright (c) 2018-2025 SuperACME Electronics Corporation Holding Limited
# SPDX-License-Identifier: Apache-2.0

config BOARD_SA6920
	select HAS_COVERAGE_SUPPORT
```

## zephyr/boards/acme/sa6920/Kconfig.defconfig
```kconfig
# Copyright (c) 2018-2025 SuperACME Electronics Corporation Holding Limited
# SPDX-License-Identifier: Apache-2.0

if BOARD_SA6920_STAR

# By default, if we build for a Non-Secure version of the board,
# force building with TF-M as the Secure Execution Environment.
config BUILD_WITH_TFM
	default y if TRUSTED_EXECUTION_NONSECURE

if SERIAL

config UART_INTERRUPT_DRIVEN
	default y

endif # SERIAL

endif
```

## zephyr/boards/acme/sa6920/board.yml
```yaml
board:
  name: sa6920
  full_name: ACME SA6920
  vendor: acme
  socs:
  - name: star
```

## zephyr/boards/acme/sa6920/sa6920_star_defconfig
```kconfig
#
# Copyright (c) 2018-2025 SuperACME Electronics Corporation Holding Limited
#
# SPDX-License-Identifier: Apache-2.0
#

CONFIG_RUNTIME_NMI=y
CONFIG_ARM_TRUSTZONE_M=y
CONFIG_ARM_MPU=y
# CONFIG_ARMV8_A_NS=y
# CONFIG_CACHE_MANAGEMENT=y
# CONFIG_DCACHE=y


# heap size
CONFIG_HEAP_MEM_POOL_SIZE=16384

# Serial
CONFIG_CONSOLE=y
CONFIG_UART_CONSOLE=y
CONFIG_SERIAL=y
CONFIG_PRINTK_SYNC=y
CONFIG_PRINTK_BUFFER_SIZE=0

# shell
CONFIG_SHELL=y
CONFIG_SHELL_BACKEND_SERIAL=y
CONFIG_SHELL_PROMPT_UART="acme:"
CONFIG_SHELL_CMD_BUFF_SIZE=90
CONFIG_SHELL_PRINTF_BUFF_SIZE=15
CONFIG_SHELL_METAKEYS=n
CONFIG_LOG=y



# Build a Secure firmware image
CONFIG_TRUSTED_EXECUTION_SECURE=y

CONFIG_XIP=n
CONFIG_SRAM_SIZE=256
CONFIG_SRAM_BASE_ADDRESS=0x1ffd0400
CONFIG_UART_NS16550_DW8250_DW_APB=y

CONFIG_MAIN_STACK_SIZE=4096
CONFIG_IDLE_STACK_SIZE=1024
CONFIG_ISR_STACK_SIZE=4096
CONFIG_SYSTEM_WORKQUEUE_STACK_SIZE=4096

CONFIG_EVENTS=y

# fs
CONFIG_POSIX_API=y


CONFIG_POSIX_AEP_CHOICE_BASE=y

CONFIG_POSIX_FILE_SYSTEM=y

CONFIG_FILE_SYSTEM=y
CONFIG_FILE_SYSTEM_SHELL=y
CONFIG_FAT_FILESYSTEM_ELM=y
CONFIG_FILE_SYSTEM_SHELL_MOUNT_COMMAND=y
CONFIG_DISK_ACCESS=y
CONFIG_DISK_DRIVERS=y
CONFIG_DISK_DRIVER_RAM=y
CONFIG_DISK_DRIVER_FLASH=n

# Enable SDHC
CONFIG_MMC_SUBSYS=y
CONFIG_DISK_DRIVER_MMC=y
CONFIG_DISK_DRIVER_SDMMC=n
CONFIG_MMC_STACK=y
CONFIG_SDHC=y
CONFIG_XLNX_SDHC=y



#CONFIG_FILE_SYSTEM_LITTLEFS=y





# clk
CONFIG_CLOCK_CONTROL=y
CONFIG_CLOCK_CONTROL_SA6920=y

# pinctrl
CONFIG_PINCTRL=y
CONFIG_PINCTRL_SA6920=y

# i2c
CONFIG_I2C=y
CONFIG_I2C_DW=y
CONFIG_I2C_SHELL=y
# gpio
CONFIG_GPIO=y
CONFIG_GPIO_DW=y
CONFIG_GPIO_SHELL=y






CONFIG_FILE_SYSTEM_MAX_TYPES=3
```

## zephyr/drivers/clock_control/Kconfig.sa6920
```kconfig
# Copyright (c) 2025 Chenqiang Zheng <zhengchengqiang@microbt.com>
# SPDX-License-Identifier: Apache-2.0

config CLOCK_CONTROL_SA6920
	bool "SA6920 clock control"
	default y
```

## zephyr/drivers/pinctrl/Kconfig.sa6920
```kconfig
# Copyright (c) 2021 Nordic Semiconductor ASA
# SPDX-License-Identifier: Apache-2.0

menuconfig PINCTRL_SA6920
	bool "Pin controller driver for SA6920 MCUs"
	default y
	help
	  Enable pin controller driver for SA6920 MCUs
```

## zephyr/drivers/sdhc/Kconfig.snps
```kconfig
# Copyright (c) 2025 Advanced Micro Devices, Inc. (AMD)
# SPDX-License-Identifier: Apache-2.0

config XLNX_SDHC
	bool "xlnx sdhc driver"
	default y
	select SDHC_SUPPORTS_NATIVE_MODE
	
	help
	  Enable xilinx SD/EMMC host controller driver

if XLNX_SDHC

# sdhc needs 32 byte aligned buffers
config SDHC_BUFFER_ALIGNMENT
	default 32

config HOST_ADMA2_DESC_SIZE
	int "Max discripter SIZE"
	default 32
	
	help
	  Set max number of discriptor support

endif
```

## zephyr/dts/bindings/clock/sa6920_clock_control.yaml
```yaml
# Copyright (c) 2023 EPAM Systems
# SPDX-License-Identifier: Apache-2.0

description: SUPER ACME 6920 SoC Clock and Software Reset

compatible: "sa6920,crg"

include: [clock-controller.yaml, base.yaml]

properties:
  "#clock-cells":
    const: 1

clock-cells:
  - id
```

## zephyr/dts/bindings/sdhc/snps,designware-sdhc.yaml
```yaml
description: Synopsys DesignWare SDHC

compatible: "snps,designware-sdhc"

include: [sdhc.yaml]

properties:
  reg:
    required: true

  clocks:
    required: true

  # pinctrl-0:
  #   required: true

  # pinctrl-names:
  #   required: true
  
  bus-width:
    type: int
    enum:
      - 1
      - 4
    default: 4

  sd-support:
    type: boolean

  mmc-support:
    type: boolean

  card-detect:
    type: boolean

  write-protect:
    type: boolean

  broken-cd:
    type: boolean
    description:
      There is no card detection available; polling must be used.
```

## zephyr/soc/acme/Kconfig.soc
```kconfig
# Copyright (c) 2024 Nordic Semiconductor ASA
# SPDX-License-Identifier: Apache-2.0

config SOC_FAMILY_ACME
	bool

config SOC_FAMILY
	default "acme" if SOC_FAMILY_ACME

rsource "*/Kconfig.soc"
```

## zephyr/soc/acme/sa6920/Kconfig
```kconfig
# Copyright (c) 2018-2025 SuperACME Electronics Corporation Holding Limited
# SPDX-License-Identifier: Apache-2.0

config SOC_SERIES_SA6920
	select ARM

config SOC_SA6920_STAR
	select CPU_CORTEX_M33
	select CPU_HAS_ARM_MPU
	select CPU_HAS_ARM_SAU
```

## zephyr/soc/acme/sa6920/Kconfig.defconfig
```kconfig
# Copyright (c) 2018-2025 SuperACME Electronics Corporation Holding Limited
# SPDX-License-Identifier: Apache-2.0

if SOC_SERIES_SA6920

config SYS_CLOCK_HW_CYCLES_PER_SEC
	default 24000000

rsource "Kconfig.defconfig.*"

endif # SOC_SERIES_SA6920
```

## zephyr/soc/acme/sa6920/Kconfig.defconfig.star
```kconfig
# Copyright (c) 2018-2025 SuperACME Electronics Corporation Holding Limited
# SPDX-License-Identifier: Apache-2.0

if SOC_SA6920_STAR

config NUM_IRQS
	default 128

endif
```

## zephyr/soc/acme/sa6920/Kconfig.soc
```kconfig
# Copyright (c) 2018-2025 SuperACME Electronics Corporation Holding Limited
# SPDX-License-Identifier: Apache-2.0

config SOC_SERIES_SA6920
	bool
	select SOC_FAMILY_ACME
	help
	  Enable support for ACME SA6920 Series

config SOC_SA6920_STAR
	bool
	select SOC_SERIES_SA6920
	help
	  ARM Cortex-M33 (STAR)

config SOC_SERIES
	default "sa6920" if SOC_SERIES_SA6920

config SOC
	default "star" if SOC_SA6920_STAR
```
