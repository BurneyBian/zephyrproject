/*
 * Copyright (c) 2018-2025 SuperACME Electronics Corporation Holding Limited
 *
 * SPDX-License-Identifier: Apache-2.0
 */

sysclk: system-clock {
	compatible = "fixed-clock";
	clock-frequency = <24000000>;
	#clock-cells = <0>;
};

uart0: uart@48020000 {
	compatible = "ns16550";
	clock-frequency = <24000000>;
	reg = <0x48020000 0x400>;
	current-speed = <115200>;
	interrupt-parent = <&nvic>;
	interrupts = <13 1>;
	reg-shift = <2>;
};
